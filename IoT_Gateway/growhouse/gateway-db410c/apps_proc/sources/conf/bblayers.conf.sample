## IoT_Gateway/growhouse/gateway-db410c/apps_proc/sources/conf/bblayers.conf.sample
```bitbake
LCONF_VERSION = "6"

BBPATH = "${TOPDIR}"
BSPDIR := "${@os.path.abspath(os.path.dirname(d.getVar('FILE', True)) + '/../..')}"

BBFILES ?= ""
BBLAYERS = " \
  ${BSPDIR}/sources/openembedded-core/meta \
  \
  ${BSPDIR}/sources/meta-openembedded/meta-oe \
  ${BSPDIR}/sources/meta-openembedded/meta-filesystems \
  ${BSPDIR}/sources/meta-openembedded/meta-gnome \
  ${BSPDIR}/sources/meta-openembedded/meta-networking \
  ${BSPDIR}/sources/meta-openembedded/meta-multimedia \
  ${BSPDIR}/sources/meta-openembedded/meta-python \
  \
  ${BSPDIR}/sources/meta-rpb \
  ${BSPDIR}/sources/meta-96boards \
  ${BSPDIR}/sources/meta-linaro/meta-linaro-toolchain \
  ${BSPDIR}/sources/meta-qcom \
  ${BSPDIR}/sources/meta-browser \
  ${BSPDIR}/sources/meta-backports \
  ${BSPDIR}/sources/meta-virtualization \
  ${BSPDIR}/sources/meta-java \
  ${BSPDIR}/sources/meta-growhouse \
  \
  ${BSPDIR}/sources/meta-games \
  \
  ${BSPDIR}/sources/vendor/qti/meta_imm \
"
```

## IoT_Gateway/growhouse/gateway-db410c/apps_proc/sources/meta-backports/conf/layer.conf
```bitbake
# We have a conf and classes directory, add to BBPATH
BBPATH .= ":${LAYERDIR}"

BBFILE_COLLECTIONS += "backports"
BBFILE_PATTERN_backports := "^${LAYERDIR}/"
BBFILE_PRIORITY_backports = "20"

# Let us add layer-specific bbappends which are only applied when that
# layer is included in our configuration
# includes customization and/or backports
BBFILES += "${@' '.join('${LAYERDIR}/%s/recipes*/*/*.bbappend' % layer \
              for layer in BBFILE_COLLECTIONS.split())}"
# Add layer-specific bb files too
BBFILES += "${@' '.join('${LAYERDIR}/%s/recipes*/*/*.bb' % layer \
              for layer in BBFILE_COLLECTIONS.split())}"
```

## IoT_Gateway/growhouse/gateway-db410c/apps_proc/sources/meta-growhouse/conf/layer.conf
```bitbake
# We have a conf and classes directory, add to BBPATH
BBPATH .= ":${LAYERDIR}"

# We have recipes-* directories, add to BBFILES
BBFILES += "${LAYERDIR}/recipes*/*/*.bb ${LAYERDIR}/recipes*/*/*.bbappend"

BBFILE_COLLECTIONS += "meta-growhouse"
BBFILE_PATTERN_meta-growhouse := "^${LAYERDIR}/"
BBFILE_PRIORITY_meta-growhouse = "6"
LAYERSERIES_COMPAT_meta-growhouse = "rocko"
```

## IoT_Gateway/growhouse/gateway-db410c/apps_proc/sources/meta-linaro/meta-ilp32/conf/machine/hikey-ilp32.conf
```bitbake
#@TYPE: Machine
#@NAME: Hikey ILP32
#@DESCRIPTION: ILP32 build for hikey.

require conf/machine/include/arm64/arch-armv8.inc

DEFAULTTUNE = "aarch64_ilp32"

PREFERRED_PROVIDER_virtual/xserver ?= "xserver-xorg"

XSERVER ?= "xserver-xorg \
            mesa-driver-swrast \
            xf86-input-evdev \
            xf86-input-mouse \
            xf86-video-fbdev \
            xf86-input-keyboard"

MACHINE_FEATURES = ""

# Don't include kernels in standard images
#RDEPENDS_kernel-base = ""

PREFERRED_PROVIDER_virtual/kernel ?= "linux-hikey-ilp32"

KERNEL_IMAGETYPE = "Image"
KERNEL_DEVICETREE = "hisilicon/hi6220-hikey.dtb"

OPTEEMACHINE = "hikey"
OPTEEOUTPUTMACHINE = "hikey"
UEFIMACHINE = "hikey"

# We have to disable SERIAL_CONSOLE due to auto-serial-console
#SERIAL_CONSOLE = "115200 ttyAMA0"

# Force auto-serial-console to be used by all image types
# Ideally this would be part of core oe or as a bbclassappend,
# but as we don't have an easy way to append a class, defining
# it here
EXTRA_IMAGE_FEATURES += "autoserial"
FEATURE_PACKAGES_autoserial = "auto-serial-console"

# we do not want to have getty running on tty1 as we run
# auto-serial-console there
USE_VT = "0"

IMAGE_FSTYPES_append = " ext4.gz"
IMAGE_ROOTFS_ALIGNMENT = "4096"
EXTRA_IMAGECMD_ext4 += " -L rootfs "

IMAGE_INSTALL_append = " kernel-image"

CMDLINE ?= "console=ttyAMA3,115200n8 root=/dev/mmcblk0p9 rootwait rw quiet efi=noruntime"

# FIXME Adding grub in the list breaks the build while
# generating the image. It still gets built without being
# in the below list as it is a dependency to edk2-hikey
MACHINE_ESSENTIAL_EXTRA_RDEPENDS += "\
    edk2-hikey \
"
```

## IoT_Gateway/growhouse/gateway-db410c/apps_proc/sources/meta-linaro/meta-optee/conf/layer.conf
```bitbake
# We might have a conf and classes directory, append to BBPATH
BBPATH .= ":${LAYERDIR}"

# We have a recipes directory, add to BBFILES
BBFILES += "${LAYERDIR}/recipes*/*/*.bb ${LAYERDIR}/recipes*/*/*.bbappend"

BBFILE_COLLECTIONS += "meta-optee"
BBFILE_PATTERN_meta-optee := "^${LAYERDIR}/"
BBFILE_PRIORITY_meta-optee = "8"
```

## IoT_Gateway/growhouse/gateway-db410c/apps_proc/sources/vendor/qti/meta_imm/conf/layer.conf
```bitbake
# We might have a conf and classes directory, append to BBPATH
BBPATH .= ":${LAYERDIR}"

# We have a packages directory, add to BBFILES
BBFILES += "${LAYERDIR}/recipes-*/*/*.bb \
            ${LAYERDIR}/recipes-*/*/*.bbappend"

BBFILE_COLLECTIONS += "imm"
BBFILE_PATTERN_imm := "^${LAYERDIR}/"
BBFILE_PRIORITY_imm = "9"
```
